#include "Display.h"
#include <TaskManager.h>
#include <logger.h>

static const uint8_t bootscreen[] =
{
        0x00, 0x60, 0x00, 0x00, 0xe0, 0xff, 0xff, 0xff, 0xff, 0xff, 0xff, 0xff,
        0xff, 0xff, 0xff, 0xff, 0x00, 0x78, 0x00, 0x00, 0xe0, 0xff, 0xff, 0xff,
        0xff, 0xff, 0xff, 0xff, 0xff, 0xff, 0xff, 0xff, 0x00, 0x7f, 0x00, 0x00,
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        0xff, 0xff, 0xff, 0xff
};


Display::Display() :
m_disp(0),
m_statusFrame(0),
m_displaySaveMode(false)
{
}

Display::~Display()
{
}

void Display::setup(BoardConfig const *const boardConfig, bool rotate)
{
    if (boardConfig->OledReset != 0)
    {
        pinMode(boardConfig->OledReset, OUTPUT);
        digitalWrite(boardConfig->OledReset, HIGH);
        delay(1);
        digitalWrite(boardConfig->OledReset, LOW);
        delay(10);
        digitalWrite(boardConfig->OledReset, HIGH);
    }

    Wire.begin(boardConfig->OledSda, boardConfig->OledScl);
    m_disp = new SSD1306(&Wire, boardConfig->OledAddr);

    if (rotate)
    {
        m_disp->rotate180();
    }

    Bitmap bitmap(m_disp->getWidth(), m_disp->getHeight());
    m_disp->display(&bitmap);

    m_displayFrameRate.setTimeout(500);
    m_displayFrameRate.start();

    m_frameTimeout.setTimeout(15 * 1000);
    m_displaySaveModeTimer.setTimeout(10 * 1000);
}

void Display::activateDisplaySaveMode()
{
    m_displaySaveMode = true;
}

void Display::setDisplaySaveTimeout(uint32_t timeout)
{
    m_displaySaveModeTimer.setTimeout(timeout * 1000);
}

void Display::activateDisplay()
{
    m_disp->displayOn();
}

void Display::deactivateDisplay()
{
    m_disp->displayOff();
}

void Display::update()
{
    if (m_displayFrameRate.hasExpired())
    {
        if (m_frames.size() > 0)
        {
            std::shared_ptr<DisplayFrame> frame = *m_frames.begin();
            Bitmap                        bitmap(m_disp);
            frame->drawStatusPage(bitmap);
            m_disp->display(&bitmap);

            if (m_frameTimeout.isRunning() == false)
            {
                m_frameTimeout.start();
                m_displaySaveModeTimer.stop();
            }
            else if (m_frameTimeout.hasExpired())
            {
                m_frames.pop_front();
                m_frameTimeout.stop();
            }
        }
        else
        {
            if (m_disp->isDisplayOn())
            {
                Bitmap bitmap(m_disp);
                m_statusFrame->drawStatusPage(bitmap);
                m_disp->display(&bitmap);

                if (m_displaySaveMode)
                {
                    if (m_displaySaveModeTimer.isRunning() && m_displaySaveModeTimer.hasExpired())
                    {
                        m_disp->displayOff();
                        m_displaySaveModeTimer.stop();
                    }
                    else if (m_displaySaveModeTimer.isRunning() == false)
                    {
                        m_displaySaveModeTimer.start();
                    }
                }
            }
        }

        m_displayFrameRate.start();
    }
}

void Display::addFrame(std::shared_ptr<DisplayFrame> frame)
{
    m_frames.push_back(frame);
}

void Display::setStatusFrame(std::shared_ptr<StatusFrame> frame)
{
    m_statusFrame = frame;
}

void Display::showSpashScreen(String firmwareTitle, String version)
{
    Bitmap bitmap(m_disp);
    bitmap.drawString(0, 10, false, firmwareTitle);
    bitmap.drawString(0, 20, false, version);
    bitmap.drawString(0, 35, false, "by Peter Buchegger");
    bitmap.drawString(30, 45, false, "OE5BPA");
    m_disp->display(&bitmap);
}

void Display::showSpashScreen(String version)
{
    Bitmap bitmap(m_disp->getWidth(), m_disp->getHeight(), bootscreen);
    bitmap.drawString(86, 56, true, version);
    m_disp->display(&bitmap);
}

void Display::showStatusScreen(String header, String text)
{
    Bitmap bitmap(m_disp);
    bitmap.drawString(0, 0, false, header);
    bitmap.drawStringLF(0, 10, false, text);
    m_disp->display(&bitmap);
}

uint16_t Display::getWidth()
{
    return m_disp->getWidth();
}

uint16_t Display::getHeight()
{
    return m_disp->getHeight();
}

void TextFrame::drawStatusPage(Bitmap &bitmap)
{
    bitmap.drawString(0, 0, false, m_header);
    bitmap.drawStringLF(0, 10, false, m_text);
}
